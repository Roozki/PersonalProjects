## CMakeLists.txt
```
cmake_minimum_required(VERSION 3.13.1)
find_package(Zephyr REQUIRED HINTS $ENV{ZEPHYR_BASE})
#light system
project(light_system_esp32)


target_include_directories(app PRIVATE 
    include
    src
)

#telling it what targets to aim for
FILE(GLOB app_sources src/*.cpp)
target_sources(app PRIVATE ${app_sources})
```

## prj.conf
```kconfig
CONFIG_STDOUT_CONSOLE=y
#CONFIG_USB_DEVICE_STACK=y
#CONFIG_USB_DEVICE_PRODUCT="LIGHT SYS"
#CONFIG_USB_DEVICE_PID=0x0001
CONFIG_LOG=y
CONFIG_USB_DRIVER_LOG_LEVEL_ERR=y
CONFIG_USB_DEVICE_LOG_LEVEL_ERR=y
CONFIG_SERIAL=y
CONFIG_UART_INTERRUPT_DRIVEN=y
CONFIG_UART_LINE_CTRL=y
#CONFIG_USB_DEVICE_INITIALIZE_AT_BOOT=n

CONFIG_GPIO=y

CONFIG_NEWLIB_LIBC=y
```

## src/main.cpp
```c
#include <light_sysESP32.h>

int main(void){

    	/* configure interrupt and callback to receive data */
	int ret = uart_irq_callback_user_data_set(uart_dev, serial_cb, NULL);

	if (ret < 0) {
		if (ret == -ENOTSUP) {
			printk("Interrupt-driven UART API support not enabled\n");
		} else if (ret == -ENOSYS) {
			printk("UART device does not support interrupt-driven API\n");
		} else {
			printk("Error setting UART callback: %d\n", ret);
		}
		return 0;
	}
	uart_irq_rx_enable(uart_dev);   
    gpio_pin_configure(gpio_dev, LED_WSB1_PIN, GPIO_OUTPUT);


	print_uart("Network AGS System Online.\r\n");

    k_timer_init(&top_timer, top_timer_cb, NULL);
  
    for(int i = 0; i < NUM_LEDS_STRIP_1; i++){
        led_strip[i].blue = 0;
        led_strip[i].green = 0;
        led_strip[i].red = 0;
    }

    



    return 0;
}
```

## include/light_sysESP32.h
```c
#pragma once
#include <light_sys_timer_callbacks.h>
#include <zephyr/kernel.h>
#include <zephyr/device.h>
#include <zephyr/drivers/uart.h>

#include <zephyr/drivers/gpio.h>
#include <zephyr/usb/usb_device.h>
#include <zephyr/usb/usbd.h>
#include <zephyr/logging/log.h>
#include <stdlib.h>
#include <vector>
#include <bitset>

#include <stdio.h>
// #include <sys/printk.h>

//gpio
#define LED_WSB1_PIN 14
#define NUM_LEDS_STRIP_1 5


#define MSG_SIZE 32


#include <string.h>
#define UART_DEVICE_NODE DT_CHOSEN(zephyr_shell_uart)

K_MSGQ_DEFINE(uart_msgq, MSG_SIZE, 10, 4);


const struct device *gpio_dev = DEVICE_DT_GET(DT_NODELABEL(gpio1));

static const struct device *uart_dev = DEVICE_DT_GET(DT_NODELABEL(uart0));

static struct k_timer top_timer;

struct LED {
   //each LED has 3 8-bit values, following GRB
   //https://www.arrow.com/en/research-and-events/articles/protocol-for-the-ws2812b-programmable-led

   uint8_t green;
   uint8_t red;
   uint8_t blue;

};

volatile LED led_strip[NUM_LEDS_STRIP_1];


static char rx_buf[MSG_SIZE];
static int rx_buf_pos;
/*
    Print a null terminated string
*/
void print_uart(char *buf)
{
	int msg_len = strlen(buf);

	for (int i = 0; i < msg_len; i++) {
		uart_poll_out(uart_dev, buf[i]);
	}
}


/*
 * Read characters from UART until line end is detected. Afterwards push the
 * data to the message queue.
 */
void serial_cb(const struct device *dev, void *user_data)
{
    //character, ASICI
	uint8_t c;

	if (!uart_irq_update(uart_dev)) {
		return;
	}

	if (!uart_irq_rx_ready(uart_dev)) {
		return;
	}

	/* read until FIFO empty */
	while (uart_fifo_read(uart_dev, &c, 1) == 1) {
		if ((c == '\n' || c == '\r') && rx_buf_pos > 0) {
			/* terminate string */
			rx_buf[rx_buf_pos] = '\0';

			/* if queue is full, message is silently dropped */
			k_msgq_put(&uart_msgq, &rx_buf, K_NO_WAIT);

			/* reset the buffer (it was copied to the msgq) */
			rx_buf_pos = 0;
		} else if (rx_buf_pos < (sizeof(rx_buf) - 1)) {
			rx_buf[rx_buf_pos++] = c;
		}
		/* else: characters beyond buffer size are dropped */
	}
}
```

## include/light_sys_timer_callbacks.h
```c
#pragma once

void top_timer_cb(struct k_timer *timer_id){

    //- One is indicated by: .8us high, .45us low
    //- Zero is indicated by: .4us high, .85us low



}
```
